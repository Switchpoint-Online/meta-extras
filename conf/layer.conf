## conf/layer.conf
```bitbake
# We have a conf and classes directory, add to BBPATH
BBPATH .= ":${LAYERDIR}"

# We have recipes-* directories, add to BBFILES
BBFILES += "${LAYERDIR}/recipes-*/*/*.bb \
            ${LAYERDIR}/recipes-*/*/*.bbappend"

BBFILE_COLLECTIONS += "meta-extras"
BBFILE_PATTERN_meta-extras = "^${LAYERDIR}/"
BBFILE_PRIORITY_meta-extras = "11"

LAYERDEPENDS_meta-extras = "core"
LAYERSERIES_COMPAT_meta-extras = "dunfell langdale kirkstone nanbield"
```
